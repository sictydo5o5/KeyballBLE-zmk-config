## config/boards/shields/Test/Kconfig.defconfig
```kconfig
if SHIELD_KEYBALLBLE_R

config ZMK_KEYBOARD_NAME
    default "KeyballBLE_R"

config ZMK_SPLIT
    default y

config ZMK_SPLIT_ROLE_CENTRAL
    default y

endif

if SHIELD_KEYBALLBLE_L

config ZMK_KEYBOARD_NAME
    default "KeyballBLE_L"

config ZMK_SPLIT
    default y

endif
```

## config/boards/shields/Test/Kconfig.shield
```kconfig
config SHIELD_KEYBALLBLE_R
    def_bool $(shields_list_contains,KeyballBLE_R)

config SHIELD_KEYBALLBLE_L
    def_bool $(shields_list_contains,KeyballBLE_L)
```
